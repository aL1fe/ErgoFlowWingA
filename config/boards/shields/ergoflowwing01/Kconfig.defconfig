## config/boards/shields/ergoflowwing01/Kconfig.defconfig
```kconfig
# Copyright (c) 2020 The ZMK Contributors
# SPDX-License-Identifier: MIT

if SHIELD_ERGOFLOWWING01_LEFT

config ZMK_KEYBOARD_NAME
    default "Ergoflowwing01"

config ZMK_SPLIT_ROLE_CENTRAL
    default y

endif

if SHIELD_ERGOFLOWWING01_LEFT || SHIELD_ERGOFLOWWING01_RIGHT

config ZMK_SPLIT
    default y

endif
```

## config/boards/shields/ergoflowwing01/Kconfig.shield
```kconfig
# Copyright (c) 2020 The ZMK Contributors
# SPDX-License-Identifier: MIT

config SHIELD_ERGOFLOWWING01_LEFT
    def_bool $(shields_list_contains,ergoflowwing01_left)

config SHIELD_ERGOFLOWWING01_RIGHT
    def_bool $(shields_list_contains,ergoflowwing01_right)
```

## config/boards/shields/ergoflowwinga/Kconfig.defconfig
```kconfig
if SHIELD_ERGOFLOWWINGA_LEFT

config ZMK_KEYBOARD_NAME
    default "ErgoFlow Wing-A"

config ZMK_SPLIT_ROLE_CENTRAL
    default y

endif

if SHIELD_ERGOFLOWWINGA_LEFT || SHIELD_ERGOFLOWWINGA_RIGHT

config ZMK_SPLIT
    default y

endif
```

## config/boards/shields/ergoflowwinga/Kconfig.shield
```kconfig
# Copyright (c) 2020 The ZMK Contributors
# SPDX-License-Identifier: MIT

config SHIELD_ERGOFLOWWINGA_LEFT
    def_bool $(shields_list_contains,ergoflowwinga_left)

config SHIELD_ERGOFLOWWINGA_RIGHT
    def_bool $(shields_list_contains,ergoflowwinga_right)
```
